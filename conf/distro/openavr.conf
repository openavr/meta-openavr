## conf/distro/openavr.conf
```bitbake
require conf/distro/poky.conf

DISTRO = "openavr"
DISTRO_NAME = "OpenAVR Yocto OS"

SDK_VENDOR = "-openavr"
TARGET_VENDOR = "-openavr"

# Enable systemd as our init manager
INIT_MANAGER = "systemd"

DISTRO_FEATURES:append = " bluez5 wifi"
VIRTUAL-RUNTIME_initscripts = ""

KERNEL_FEATURES:append = "\
    features/device-mapper/dm-verity.scc \
"

PACKAGE_CLASSES = "package_ipk"
NO_RECOMMENDATIONS = "1"

# Set `DEBUG_OPENAVR_INIT = "debug-openavr-init"` in local.conf to enable
# stopping in the middle of the initrd before pivoting into the main rootfs.
DEBUG_OPENAVR_INIT ?= ""

require conf/machine/openavr-machine-extra.conf

INHERIT += "image-buildinfo"

IMAGE_BUILDINFO_VARS:append = " \
    DISTRO_CODENAME \
    IMAGE_BASENAME \
    IMAGE_NAME \
    MACHINEOVERRIDES \
    MACHINE_ARCH \
    SDK_NAME \
    SUMMARY \
    USER \
    DATETIME \
"
```

## conf/layer.conf
```bitbake
# We have a conf and classes directory, add to BBPATH
BBPATH .= ":${LAYERDIR}"

# We have recipes-* directories, add to BBFILES
BBFILES += "${LAYERDIR}/recipes-*/*/*.bb \
            ${LAYERDIR}/recipes-*/*/*.bbappend"

BBFILE_COLLECTIONS += "meta-openavr"
BBFILE_PATTERN_meta-openavr = "^${LAYERDIR}/"
BBFILE_PRIORITY_meta-openavr = "8"

LAYERDEPENDS_meta-openavr = "core"
LAYERSERIES_COMPAT_meta-openavr = "honister"

# The dynamic-layers directory hosts the extensions and layer specific
# modifications.
#
# The .bbappend and .bb files are included if the respective layer
# collection is available.
BBFILES += "${@' '.join('${LAYERDIR}/dynamic-layers/%s/recipes*/*/*.bbappend' % layer \
               for layer in BBFILE_COLLECTIONS.split())}"
BBFILES += "${@' '.join('${LAYERDIR}/dynamic-layers/%s/recipes*/*/*.bb' % layer \
               for layer in BBFILE_COLLECTIONS.split())}"

BBFILES_DYNAMIC += " \
    meta-ti:${LAYERDIR}/dynamic-layers/meta-ti/*/*/*.bb \
    meta-ti:${LAYERDIR}/dynamic-layers/meta-ti/*/*/*.bbappend \
"
```

## conf/machine/beagleboneai.conf
```bitbake
#@TYPE: Machine
#@NAME: BeagleBone AI
#@DESCRIPTION: Machine configuration for the BeagleBone AI

require conf/machine/include/dra7xx.inc

KERNEL_DEVICETREE = " \
    am5729-beagleboneai.dtb \
"

UBOOT_MACHINE = "am57xx_evm_config"

IMAGE_BOOT_FILES = "MLO u-boot.img"
```

## conf/machine/openavr-machine-extra.conf
```bitbake
# Override or modify variables from the `${MACHINE}.conf` machine definition
# file.

WKS_FILE:beaglebone-yocto = "openavr-beaglebone.wks"
WKS_FILE = "openavr-sdcard.wks"

# Do not update fstab file when using wic images since mounting is all done in
# the initramfs.
WIC_CREATE_EXTRA_ARGS:append = " --no-fstab-update"

IMAGE_FSTYPES = "squashfs-xz wic.gz wic.bmap"

INITRAMFS_IMAGE = "openavr-image-initramfs"
INITRAMFS_IMAGE_BUNDLE = "1"

IMAGE_BOOT_FILES:remove:beaglebone-yocto = "zImage"
IMAGE_BOOT_FILES:append:beaglebone-yocto = "\
    zImage-initramfs-${MACHINE}.bin;zImage \
    boot.scr \
"

IMAGE_BOOT_FILES:append:beagleboneai = "\
    zImage-initramfs-${MACHINE}.bin;zImage \
    am5729-beagleboneai.dtb \
    boot.scr \
"

IMAGE_BOOT_FILES:append:beaglebone-ai64 = "\
    Image-initramfs-${MACHINE}.bin;Image \
    k3-j721e-beagleboneai64.dtb;ti/k3-j721e-beagleboneai64.dtb \
    k3-j721e-common-proc-board.dtb;ti/k3-j721e-common-proc-board.dtb \
    k3-j721e-proc-board-tps65917.dtb;ti/k3-j721e-proc-board-tps65917.dtb \
    k3-j721e-sk.dtb;ti/k3-j721e-sk.dtb \
    u-boot.dtb \
    boot.scr \
"

IMAGE_BOOT_FILES:append:rpi = " uImage-initramfs-${MACHINE}.bin;uImage"

CMDLINE_ROOT_FSTYPE:rpi = ""
CMDLINE_ROOTFS:rpi = ""

DISABLE_RPI_BOOT_LOGO:rpi = "1"
DISABLE_SPLASH:rpi = "1"
RPI_USE_U_BOOT:rpi = "1"
ENABLE_UART:rpi = "1"
CMDLINE:append:rpi = " rdinit=init ${DEBUG_OPENAVR_INIT}"

# Without this, the `fdt addr ${fdt_addr}` command fails in u-boot
# when no hdmi display is connected (running headless).
HDMI_FORCE_HOTPLUG:rpi = "1"

# group: DMT
HDMI_GROUP:rpi = "2"

# mode: 1920x1200 60Hz
#HDMI_MODE:rpi = "69"

# mode: 1080p 60Hz
HDMI_MODE:rpi = "82"

MACHINE_FEATURES:remove:beaglebone-ai64 = "efi"
```

## wic/openavr-beaglebone.wks
```
# short-description: Create SD card image for Beaglebone
# long-description: Creates a partitioned SD card image for Beaglebone.

include openavr-common.inc

bootloader --append="console=ttyS0,115200"
```
